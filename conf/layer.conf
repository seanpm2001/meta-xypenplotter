## conf/layer.conf
```bitbake
# We have a conf and classes directory, append to BBPATH
BBPATH .= ":${LAYERDIR}"

# We have a recipes directory, add to BBFILES
BBFILES += "${LAYERDIR}/recipes*/*/*.bb ${LAYERDIR}/recipes*/*/*.bbappend"

BBFILE_COLLECTIONS += "meta-xyplotter"
BBFILE_PATTERN_meta-xyplotter := "^${LAYERDIR}/"
BBFILE_PRIORITY_meta-xyplotter = "98"
```
